## part_3/buildroot-project-2022h/external/package/mas245/can_pingpong/Config.in
```kconfig
config BR2_PACKAGE_CAN_PINGPONG
   bool "can_pingpong"
   depends on BR2_INSTALL_LIBSTDCPP
   depends on BR2_PACKAGE_LIBSOCKETCAN
   depends on BR2_PACKAGE_QT5
   depends on BR2_PACKAGE_IPROUTE2
   help
      Sender en CAN-melding ved oppstart. Deretter kopieres alle meldinger som mottas og sendes tilbake på bus-en.

comment "can_pingpong needs a toolchain w/ C++, libsocketcan, qt5, iproute2"
   depends on !BR2_INSTALL_LIBSTDCPP || !BR2_PACKAGE_LIBSOCKETCAN || !BR2_PACKAGE_QT5 || !BR2_PACKAGE_IPROUTE2
```
